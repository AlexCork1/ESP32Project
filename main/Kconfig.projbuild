## main/Kconfig.projbuild
```kconfig
# put here your custom config value
menu "My Configuration"
    config ESP_WIFI_SSID
        string "WiFi SSID"
        default "MyWiFi"
        help
            SSID (network name) for the example to connect to.

    config ESP_WIFI_PASSWORD
        string "WiFi Password"
        default "blablabla"
        help
            WiFi password (WPA or WPA2) for the example to use.
    
          
    config BROKER_URL
        string "Broker URL"
        default "mqtts://test.mosquitto.org:8884"
        help
            URL of the broker to connect to
        
                
    config MQTT_READ_TOPIC
        string "MQTT topic request"
        default "/assignment/sensor/get"
        help
            MQTT topic where user needs to send message
                    
    config MQTT_READ_MSG
        string "MQTT message request"
        default "READ"
        help
            MQTT data that must be send to ESP32
            
    config MQTT_PUBLISH_TOPIC
        string "MQTT topic publish"
        default "/assignment/sensor/publish"
        help
            MQTT topic where ESP32 will publish it's data
            
     config FIRMWARE_UPGRADE_URL
        string "URL address with update file name added"
        default "https://univerzamb-my.sharepoint.com/:u:/g/personal/ales_cep_um_si/EX86wVj0Dr5LlzeB8gZfo6gBBPPjZbScW9q_QHlGEl3hXg?e=toRkee"
        help
            URL address of firmware file that will be uploaded to the board
                       
    config MQTT_TRIGGER_UPDATE_TOPIC
        string "MQTT trigger update topic"
        default "/assignment/update"
        help
            MQTT topic that must be send to ESP32 to update and restart firmware
            
    choice ESP_WIFI_SAE_MODE
        prompt "WPA3 SAE mode selection"
        default ESP_WPA3_SAE_PWE_BOTH
        help
            Select mode for SAE as Hunt and Peck, H2E or both.
        config ESP_WPA3_SAE_PWE_HUNT_AND_PECK
            bool "HUNT AND PECK"
        config ESP_WPA3_SAE_PWE_HASH_TO_ELEMENT
            bool "H2E"
        config ESP_WPA3_SAE_PWE_BOTH
            bool "BOTH"
    endchoice

    config ESP_WIFI_PW_ID
        string "PASSWORD IDENTIFIER"
        depends on  ESP_WPA3_SAE_PWE_HASH_TO_ELEMENT|| ESP_WPA3_SAE_PWE_BOTH
        default ""
        help
            password identifier for SAE H2E

    config ESP_MAXIMUM_RETRY
        int "Maximum retry"
        default 5
        help
            Set the Maximum retry to avoid station reconnecting to the AP unlimited when the AP is really inexistent.

    choice ESP_WIFI_SCAN_AUTH_MODE_THRESHOLD
        prompt "WiFi Scan auth mode threshold"
        default ESP_WIFI_AUTH_WPA2_PSK
        help
            The weakest authmode to accept in the scan mode.
            This value defaults to ESP_WIFI_AUTH_WPA2_PSK incase password is present and ESP_WIFI_AUTH_OPEN is used.
            Please select ESP_WIFI_AUTH_WEP/ESP_WIFI_AUTH_WPA_PSK incase AP is operating in WEP/WPA mode.

        config ESP_WIFI_AUTH_OPEN
            bool "OPEN"
        config ESP_WIFI_AUTH_WEP
            bool "WEP"
        config ESP_WIFI_AUTH_WPA_PSK
            bool "WPA PSK"
        config ESP_WIFI_AUTH_WPA2_PSK
            bool "WPA2 PSK"
        config ESP_WIFI_AUTH_WPA_WPA2_PSK
            bool "WPA/WPA2 PSK"
        config ESP_WIFI_AUTH_WPA3_PSK
            bool "WPA3 PSK"
        config ESP_WIFI_AUTH_WPA2_WPA3_PSK
            bool "WPA2/WPA3 PSK"
        config ESP_WIFI_AUTH_WAPI_PSK
            bool "WAPI PSK"
    endchoice
  
endmenu
```
